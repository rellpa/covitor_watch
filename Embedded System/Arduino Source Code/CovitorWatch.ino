#include <Wire.h>
#include "BluetoothSerial.h"
#include <Adafruit_GFX.h>
#include <Adafruit_SSD1306.h>
#include "RTClib.h"
#include "MAX30100_PulseOximeter.h"
#include "Protocentral_MAX30205.h"
#include "OneButton.h"

#define REPORTING_PERIOD_MS 1000
#define SCREEN_WIDTH 128
#define SCREEN_HEIGHT 64

Adafruit_SSD1306 display(SCREEN_WIDTH, SCREEN_HEIGHT, &Wire, -1);

BluetoothSerial SerialBT;
RTC_DS1307 RTC;
PulseOximeter pox;
MAX30205 tempSensor;
uint32_t tsLastReport = 0;
long int data;
int buttonPin = 18;
OneButton button(buttonPin, true);
uint8_t btn_prev;
int Vdatatemp = 12; 
int Vdataheart = 12; 
int Vdatasaturation = 12; 
long int heartratecommand = 20;
long int oxygensaturationcommand = 21;
long int temperaturecommand = 22;
long int temperatureid = 23;
long int heartrateid = 24;
long int saturationid = 25;
int page = 2; //clock = 1, heart rate = 2, temperature = 3, bluetooth sycn = 4, QR Code = 5, turn off display = 6, menu = 7
int old_page = page;
int bt = 0;
int bluetoothcommand = 0;
int menuItem = 1; //clock = 1, heart rate = 2, temperature = 3, bluetooth sycn = 4 ,QR Code = 5, turn off display = 6, restart device = 7
RTC_DS1307 DS1307_RTC;

static const uint8_t image_data_qrkekl[1024] = {
  0xff, 0xff, 0xff, 0xff, 0xff, 0xff, 0xff, 0xff, 0xff, 0xff, 0xff, 0xff, 0xff, 0xff, 0xff, 0xff, 
  0xff, 0xff, 0xff, 0xff, 0xff, 0xff, 0xff, 0xff, 0xff, 0xff, 0xff, 0xff, 0xff, 0xff, 0xff, 0xff, 
  0xff, 0xff, 0xff, 0xff, 0xff, 0xff, 0xff, 0xff, 0xff, 0xff, 0xff, 0xff, 0xff, 0xff, 0xff, 0xff, 
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  0xff, 0xff, 0xff, 0xff, 0xff, 0xff, 0xff, 0xff, 0xff, 0xff, 0xff, 0xff, 0xff, 0xff, 0xff, 0xff
};

void onBeatDetected()
{
    Serial.println("Beat!");
}

void page_heartratesensor(){
    display.clearDisplay();
    // display BPM
    display.setTextSize(1);
    display.setCursor(0,0);
    display.print("BPM: ");
    display.setTextSize(2);
    display.setCursor(0,10);
    display.print(String(pox.getHeartRate()));
    display.print(" ");
    display.setTextSize(2);
    display.print("bpm");
    // display SPO2
    display.setTextSize(1);
    display.setCursor(0, 35);
    display.print("SpO2: ");
    display.setTextSize(2);
    display.setCursor(0, 45);
    display.print(String(pox.getSpO2()));
    display.print(" %"); 
    display.display();
}
void page_temperaturesensor(){
    display.clearDisplay();
    // display temperature
    display.setTextSize(1);
    display.setCursor(0,0);
    display.print("temperature: ");
    display.setTextSize(2);
    display.setCursor(0,10);
    display.print(String(Vdatatemp));
    display.print(" ");
    display.setTextSize(1);
    display.cp437(true);
    display.write(167);
    display.setTextSize(2);
    display.print("C");
    display.display();
}
void page_qrcode(){
    display.clearDisplay();
    display.drawBitmap(0, 0, image_data_qrkekl, 128, 64, 1);
    display.display();
}
void page_menu(){
    display.clearDisplay();
    display.setTextSize(1);
    display.setTextColor(WHITE);
    display.setCursor(30, 0);
    display.print("Menu Page");
    if (menuItem == 1) {
      display.setCursor(5, 17);
      display.setTextColor(WHITE);
      display.print("> Clock");
    } else {
      display.setCursor(5, 17);
      display.setTextColor(WHITE);
      display.print("  Clock");
    }

    if (menuItem == 2) {
      display.setCursor(5, 27);
      display.setTextColor(WHITE);
      display.print("> Heart Rate Sensor");
    } else {
      display.setCursor(5, 27);
      display.setTextColor(WHITE);
      display.print("  Heart Rate Sensor");
    }

    if (menuItem == 3) {
      display.setCursor(5, 37);
      display.setTextColor(WHITE);
      display.print("> Temperature Sensor");
    } else {
      display.setCursor(5, 37);
      display.setTextColor(WHITE);
      display.print("  Temperature Sensor");
    }

    if (menuItem == 4) {
      display.setCursor(5, 47);
      display.setTextColor(WHITE);
      display.print("> Bluetooth Sync");
    } else {
      display.setCursor(5, 47);
      display.setTextColor(WHITE);
      display.print("  Bluetooth Sync");
    }
    display.display();
}

void page_clock(){
    display.clearDisplay();
    display.setTextSize(1);
    DateTime now = RTC.now();
    display.setCursor(40,30);
    display.setTextSize(1);
    display.print(now.day());
    display.print('/');
    display.print(now.month());
    display.print('/');
    display.print(now.year());
    display.print(' ');
    display.setCursor(40, 40);
    display.print(now.hour());
    display.print(':');
    display.print(now.minute());
    display.print(':');
    display.print(now.second());
    display.setTextSize(1);
    display.setTextColor(WHITE);
    display.setCursor(10, 4);
    // Display static text
    display.println("Digital Clock");
    display.display(); 
}

void page_bluetooth(){
    if(bluetoothcommand == 0){
          display.clearDisplay();
          // display temperature
          display.setTextSize(1);
          display.setCursor(0,0);
          display.print("Bluetooth Pairing");
          display.display();
    }
    if(bluetoothcommand == 1){
          display.clearDisplay();
          display.setTextSize(1);
          display.setCursor(0,0);
          display.print("Bluetooth Sync");
          display.setTextSize(1);
          display.setCursor(0, 35);
          display.print("Heart Rate: ");
          display.setTextSize(2);
          display.setCursor(0, 45);
          display.print(String(Vdataheart));
          display.print(" bpm"); 
          display.display();
    }
    if(bluetoothcommand == 2){
          display.clearDisplay();
          display.setTextSize(1);
          display.setCursor(0,0);
          display.print("Bluetooth Sync");
          display.setTextSize(1);
          display.setCursor(0, 35);
          display.print("Saturation: ");
          display.setTextSize(2);
          display.setCursor(0, 45);
          display.print(String(Vdatasaturation));
          display.print(" %"); 
          display.display();
    }
    if(bluetoothcommand == 3){
          display.clearDisplay();
          display.setTextSize(1);
          display.setCursor(0,0);
          display.print("Bluetooth Sync");
          display.setTextSize(1);
          display.setCursor(0, 35);
          display.print("Temperature: ");
          display.setTextSize(2);
          display.setCursor(0, 45);
          Vdatatemp = tempSensor.getTemperature();
          display.print(String(Vdatatemp));
          display.setTextSize(1);
          display.cp437(true);
          display.write(167);
          display.setTextSize(2);
          display.print("C"); 
          display.display();
    }
    if(SerialBT.available()>0){
      data = SerialBT.parseInt();
        if (data == heartratecommand){
          Serial.println("Heart Rate Mode");
          bluetoothcommand = 1;
          data = 0; 
        } if ( data == oxygensaturationcommand){
          Serial.println("Oxygen Saturation Mode");
          bluetoothcommand = 2;
          data = 0;
        } if ( data == temperaturecommand){
          Serial.println("Temperature Mode");
          bluetoothcommand = 3;
          data = 0;
        }
        if ( data == temperatureid){
          Vdatatemp = tempSensor.getTemperature();
          Serial.print("data: "); 
          Serial.println(Vdatatemp);
          Serial.println("________________");
          SerialBT.println(Vdatatemp);
          data = 0;
        }
        if ( data == heartrateid){
          Serial.print("data: "); 
          Serial.println(Vdataheart);
          Serial.println("________________");
          SerialBT.println(Vdataheart);
          data = 0;
        }
        if ( data == saturationid){
          Serial.print("data: "); 
          Serial.println(Vdatasaturation);
          Serial.println("________________");
          SerialBT.println(Vdatasaturation);
          data = 0;
        }
        delay(1000);
    } 
}

void setup(){ 
     Serial.begin(115200); 
           if (!pox.begin()) {
          Serial.println("FAILED");
          for(;;);
      } else {
          Serial.println("SUCCESS");
      }
      pox.setIRLedCurrent(MAX30100_LED_CURR_7_6MA);
      pox.setOnBeatDetectedCallback(onBeatDetected);
     Wire.begin();
     if(!display.begin(SSD1306_SWITCHCAPVCC, 0x3C)){
        Serial.println(F("SSD1306 allocation failed"));
        for(;;);
     }
     while(!tempSensor.scanAvailableSensors()){
        Serial.println("Couldn't find the temperature sensor, please connect the sensor." );
        delay(3000);
      }
    tempSensor.begin(); 
    if (! RTC.begin()) {
      Serial.println("RTC TIDAK TERBACA");
      while (1);
    }
    if (! RTC.isrunning()) {
      Serial.println("RTC is NOT running!");
      RTC.adjust(DateTime(F(__DATE__), F(__TIME__)));//update rtc dari waktu komputer
    }
    display.clearDisplay();
    display.setTextColor(WHITE);
    pinMode(buttonPin, INPUT_PULLUP);
    button.attachClick(changeMenuItem);
    button.attachDoubleClick(doubleClick);
    button.attachMultiClick(QRpage);
    button.attachLongPressStop(Idle);
}

void loop(){
  button.tick();
  if ( page == 1){
    page_clock();
  }
  if ( page == 2){
    pox.update();
    if (millis() - tsLastReport > REPORTING_PERIOD_MS) {
      Vdataheart = pox.getHeartRate();
      Vdatasaturation = pox.getSpO2();
      page_heartratesensor();
      tsLastReport = millis();
    }
  }
  if ( page == 3){
    if (millis() - tsLastReport > REPORTING_PERIOD_MS) {
      Vdatatemp = tempSensor.getTemperature();
      if(Vdatatemp != 0){
        page_temperaturesensor();
      }
      tsLastReport = millis();
    }
  }
  if ( page == 4){
    page_bluetooth();
  }
  if ( page == 5){
    page_qrcode();
  }
  if ( page == 6){
    display.ssd1306_command(SSD1306_DISPLAYOFF);
  }
  if ( page == 7){
    page_menu();
  }
}

void doubleClick()
{
      if (page == 6){
        display.ssd1306_command(SSD1306_DISPLAYON);
      }
      if (page == 7){
        if (page == 7 && menuItem == 1) {
          old_page = page;
          page = 1;
        } else if (page == 7 && menuItem == 2) {
          old_page = page;
          page = 2;
          ESP.restart();
        } else if (page == 7 && menuItem == 3) {
          old_page = page;
          page = 3;
        } else if (page == 7 && menuItem == 4) {
          old_page = page;
          page = 4;
          SerialBT.begin("CovitorWatch");
          bt = 1;
        }
    }
    else if (page == 1 || page == 2 || page == 3 || page == 4 || page == 5 || page == 6 && bt == 0) {
      page = 7;
    } else if (page == 1 || page == 2 || page == 3 || page == 4 || page == 5 || page == 6 && bt == 1) {
      ESP.restart();
    }
}

void changeMenuItem()
{
    menuItem ++;
    if (menuItem > 4)menuItem = 1;
}

void QRpage()
{
    old_page = page;
    page = 5;
}

void Idle()
{
  if(page != 6){
      old_page = page;
      page = 6;
  }
}
